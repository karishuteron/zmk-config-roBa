## config/west.yml
```yaml
manifest:
  remotes:
    - name: zmkfirmware
      url-base: https://github.com/zmkfirmware
    - name: badjeff
      url-base: https://github.com/badjeff
  projects:
    - name: zmk
      remote: zmkfirmware
      # Keep this SHA in sync with .github/workflows/build.yml.
      revision: 904c9aec8822d79149d42c8a9a77e8828eb08f5a
      import: app/west.yml
    - name: zmk-input-processor-report-rate-limit
      remote: badjeff
      revision: b056cb135525933743e2627150fb390f9d4b2461
  self:
    path: config
```

## dts/bindings/behaviors/zmk,behavior-pmw3610-cpi.yaml
```yaml
description: PMW3610 CPI adjustment behavior
compatible: "zmk,behavior-pmw3610-cpi"
include: one_param.yaml
```
